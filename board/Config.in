## board/Config.in
```kconfig
menu "BSP         Configuration"
choice
    prompt "Board Selection"

source "board/bk7231devkitc/Config.in"
if AOS_BOARD_BK7231
    config AOS_BUILD_BOARD
        default "bk7231devkitc"

    source "platform/mcu/bk7231/Config.in"
    source "platform/arch/arm/armv5/Config.in"
endif

endchoice

endmenu
```
